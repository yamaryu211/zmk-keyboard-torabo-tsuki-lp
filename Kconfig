## Kconfig
```kconfig
config ZMK_INPUT_PROCESSOR_SCROLL_ACCELERATION
    bool "Enable scroll acceleration input processor"
    default y
    depends on ZMK_POINTING

config ZMK_INPUT_PROCESSOR_SCROLL_INERTIA
    bool "Enable inertia scrolling input processor for REL_X/Y trackpads"
    default y
    depends on ZMK_POINTING

config TORABO_SPLIT_PERIPHERAL_ADV_RECOVERY
    bool "Recover split peripheral advertising"
    default y if SHIELD_TORABO_TSUKI_LP_LEFT
    depends on BT && ZMK_SPLIT && !ZMK_SPLIT_ROLE_CENTRAL
    help
      Periodically retries split BLE advertising while the peripheral is
      disconnected. This recovers from a transient advertising-start failure
      without requiring a power cycle of the peripheral half.

if TORABO_SPLIT_PERIPHERAL_ADV_RECOVERY

config TORABO_SPLIT_PERIPHERAL_ADV_RECOVERY_INITIAL_DELAY_MS
    int "Initial advertising recovery delay in milliseconds"
    default 1500
    range 100 60000

config TORABO_SPLIT_PERIPHERAL_ADV_RECOVERY_INTERVAL_MS
    int "Advertising recovery interval in milliseconds"
    default 3000
    range 500 60000

endif
```

## config/west.yml
```yaml
manifest:
  remotes:
    - name: zmkfirmware
      url-base: https://github.com/zmkfirmware
    - name: sekigon-gonnoc
      url-base: https://github.com/sekigon-gonnoc
    - name: badjeff
      url-base: https://github.com/badjeff
    - name: te9no
      url-base: https://github.com/te9no
    - name: kot149
      url-base: https://github.com/kot149
    - name: elpekenin
      url-base: https://github.com/elpekenin
    - name: yamaryu211
      url-base: https://github.com/yamaryu211
    - name: cormoran
      url-base: https://github.com/cormoran
  projects:
    - name: zmk
      remote: cormoran
      revision: main+dya
      import: app/west.yml
    - name: zmk-component-bmp-boost
      remote: sekigon-gonnoc
      import: west.yml
      revision: master
    - name: zmk-feature-status-led
      remote: sekigon-gonnoc
      revision: main
    - name: zmk-driver-paw3222
      remote: sekigon-gonnoc
      revision: torabo-tsuki
    - name: zmk-driver-iqs7211e
      remote: sekigon-gonnoc
    - name: zmk-feature-cdc-acm-bootloader-trigger
      remote: sekigon-gonnoc
      revision: main
    - name: zmk-feature-non-lipo-battery-management
      remote: sekigon-gonnoc
      revision: main
    - name: zmk-input-processor-report-rate-limit
      remote: badjeff
      revision: main
    - name: zmk-input-processor-keybind
      remote: te9no
      revision: main
    - name: zmk-scroll-snap
      remote: yamaryu211
      revision: yamaryu211
    - name: zmk-userspace
      remote: elpekenin
      revision: main
    - name: zmk-input-processor-temp-layer-threshold
      remote: yamaryu211
      revision: feat/zmk0.4
    - name: zmk-pointing-acceleration
      remote: yamaryu211
      revision: main
    - name: zmk-module-ble-management
      remote: cormoran
      revision: main
    - name: zmk-module-battery-history
      remote: cormoran
      revision: main
    - name: zmk-module-settings-rpc
      remote: cormoran
      revision: main
    - name: zmk-module-runtime-input-processor
      remote: cormoran
      revision: main
    - name: zmk-feature-custom-settings
      remote: cormoran
      revision: main
    - name: zmk-feature-runtime-combo
      remote: cormoran
      revision: main
    - name: zmk-feature-runtime-macro
      remote: cormoran
      revision: main
    - name: zmk-feature-os-detection
      remote: cormoran
      revision: main
    - name: zmk-feature-default-layer
      remote: cormoran
      revision: codex/custom-rpc-rewrite
      import: true
    - name: zmk-feature-device-info
      remote: cormoran
      revision: main
    - name: zmk-feature-kscan-diagnostics
      remote: cormoran
      revision: main
    - name: zmk-feature-watchdog
      remote: cormoran
      revision: main
    - name: zmk-feature-input-stream
      remote: cormoran
      revision: main
  self:
    path: config
```

## dts/bindings/zmk,input-processor-scroll-inertia.yaml
```yaml
# SPDX-License-Identifier: MIT

description: |
  Inertia scrolling input processor for REL_X/REL_Y trackpads (without scroller-mode).
  Tracks XY velocity while the finger moves, then injects decaying XY events after
  the finger is lifted (detected by idle-timeout-ms with no incoming events).
  Injected events flow through the full listener chain including zip_xy_to_scroll_mapper.

  Place this processor FIRST in each sub-node of the input listener so that it
  receives raw XY events before they are converted to scroll events.

compatible: "zmk,input-processor-scroll-inertia"

properties:
  "#input-processor-cells":
    type: int
    required: true
    const: 0

  decay-permille:
    type: int
    default: 920
    description: |
      Velocity multiplier applied every 10 ms tick (permille).
      920 means velocity = velocity * 0.92 per tick.
      Lower values stop sooner; higher values coast longer (1–999).

  stop-threshold-q8:
    type: int
    default: 96
    description: |
      Inertia stops when absolute velocity falls below this value (Q8 fixed-point).
      256 equals 1 XY unit per 10 ms tick. Default 96 ≈ 0.375 units/tick.
      Lower values allow longer coasting.

  idle-timeout-ms:
    type: int
    default: 50
    description: |
      Milliseconds of no incoming XY events before inertia starts.
      Should be longer than the inter-event gap during normal scrolling (~10 ms).

  track-remainders:
    type: boolean
    description: |
      Required by zmk,input-listener for remainder-tracking slot allocation.
      The inertia processor itself does not use remainders.

input-processor-cells: []
```
